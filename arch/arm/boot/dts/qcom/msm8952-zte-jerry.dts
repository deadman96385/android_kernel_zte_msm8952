/*
 * Copyright (c) 2015, The Linux Foundation. All rights reserved.
 *
 * This program is free software; you can redistribute it and/or modify
 * it under the terms of the GNU General Public License version 2 and
 * only version 2 as published by the Free Software Foundation.
 *
 * This program is distributed in the hope that it will be useful,
 * but WITHOUT ANY WARRANTY; without even the implied warranty of
 * MERCHANTABILITY or FITNESS FOR A PARTICULAR PURPOSE.  See the
 * GNU General Public License for more details.
 */

/dts-v1/;

#include "msm8952-mtp.dtsi"
#include "zte-msm8952-jerry.dtsi"

/ {
	model = "Qualcomm Technologies, Inc. ZTE MSM8952 JERRY";
	compatible = "qcom,msm8952-mtp", "qcom,msm8952", "qcom,mtp";
	qcom,board-id= <102 0>;
};
&soc {
        zte-hall {
                compatible = "zte-hall";
                hall_en{	                      
                        label = "hall_en";	
                        gpios = <&msm_gpio 46 0x0>;
            	};	
        };      
};
